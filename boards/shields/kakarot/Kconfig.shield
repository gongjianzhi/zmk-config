## boards/shields/kakarot/Kconfig.shield
```kconfig
# No whitespace after the comma or in your part name!
config SHIELD_KAKAROT_LEFT
    def_bool $(shields_list_contains,kakarot_left)

# No whitespace after the comma or in your part name!
config SHIELD_KAKAROT_RIGHT
    def_bool $(shields_list_contains,kakarot_right)
```
